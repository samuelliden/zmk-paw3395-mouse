## build/paw3395_test/Kconfig/soc/Kconfig.sysbuild
```kconfig
# Load Sysbuild SoC Kconfig descriptions.
osource "/workspaces/unified-zmk-config-template/zephyr/soc/xlnx/zynqmp/Kconfig.sysbuild"
osource "/workspaces/unified-zmk-config-template/zephyr/soc/xlnx/zynq7000/Kconfig.sysbuild"
osource "/workspaces/unified-zmk-config-template/zephyr/soc/xen/Kconfig.sysbuild"
osource "/workspaces/unified-zmk-config-template/zephyr/soc/wch/ch32v/Kconfig.sysbuild"
osource "/workspaces/unified-zmk-config-template/zephyr/soc/ti/simplelink/Kconfig.sysbuild"
osource "/workspaces/unified-zmk-config-template/zephyr/soc/ti/lm3s6965/Kconfig.sysbuild"
osource "/workspaces/unified-zmk-config-template/zephyr/soc/ti/k3/Kconfig.sysbuild"
osource "/workspaces/unified-zmk-config-template/zephyr/soc/telink/tlsr/Kconfig.sysbuild"
osource "/workspaces/unified-zmk-config-template/zephyr/soc/starfive/jh71xx/Kconfig.sysbuild"
osource "/workspaces/unified-zmk-config-template/zephyr/soc/st/stm32/Kconfig.sysbuild"
osource "/workspaces/unified-zmk-config-template/zephyr/soc/snps/qemu_arc/Kconfig.sysbuild"
osource "/workspaces/unified-zmk-config-template/zephyr/soc/snps/nsim/arc_v/Kconfig.sysbuild"
osource "/workspaces/unified-zmk-config-template/zephyr/soc/snps/nsim/arc_classic/Kconfig.sysbuild"
osource "/workspaces/unified-zmk-config-template/zephyr/soc/snps/hsdk4xd/Kconfig.sysbuild"
osource "/workspaces/unified-zmk-config-template/zephyr/soc/snps/hsdk/Kconfig.sysbuild"
osource "/workspaces/unified-zmk-config-template/zephyr/soc/snps/emsk/Kconfig.sysbuild"
osource "/workspaces/unified-zmk-config-template/zephyr/soc/snps/emsdp/Kconfig.sysbuild"
osource "/workspaces/unified-zmk-config-template/zephyr/soc/snps/arc_iot/Kconfig.sysbuild"
osource "/workspaces/unified-zmk-config-template/zephyr/soc/silabs/Kconfig.sysbuild"
osource "/workspaces/unified-zmk-config-template/zephyr/soc/sifive/sifive_freedom/Kconfig.sysbuild"
osource "/workspaces/unified-zmk-config-template/zephyr/soc/sensry/Kconfig.sysbuild"
osource "/workspaces/unified-zmk-config-template/zephyr/soc/rockchip/Kconfig.sysbuild"
osource "/workspaces/unified-zmk-config-template/zephyr/soc/renode/riscv_virtual/Kconfig.sysbuild"
osource "/workspaces/unified-zmk-config-template/zephyr/soc/renode/cortex_r8_virtual/Kconfig.sysbuild"
osource "/workspaces/unified-zmk-config-template/zephyr/soc/renesas/smartbond/Kconfig.sysbuild"
osource "/workspaces/unified-zmk-config-template/zephyr/soc/renesas/rzt2m/Kconfig.sysbuild"
osource "/workspaces/unified-zmk-config-template/zephyr/soc/renesas/rz/Kconfig.sysbuild"
osource "/workspaces/unified-zmk-config-template/zephyr/soc/renesas/rcar/Kconfig.sysbuild"
osource "/workspaces/unified-zmk-config-template/zephyr/soc/renesas/ra/Kconfig.sysbuild"
osource "/workspaces/unified-zmk-config-template/zephyr/soc/realtek/ec/Kconfig.sysbuild"
osource "/workspaces/unified-zmk-config-template/zephyr/soc/raspberrypi/rpi_pico/Kconfig.sysbuild"
osource "/workspaces/unified-zmk-config-template/zephyr/soc/quicklogic/eos_s3/Kconfig.sysbuild"
osource "/workspaces/unified-zmk-config-template/zephyr/soc/qemu/virt_riscv/Kconfig.sysbuild"
osource "/workspaces/unified-zmk-config-template/zephyr/soc/qemu/malta/Kconfig.sysbuild"
osource "/workspaces/unified-zmk-config-template/zephyr/soc/openisa/rv32m1/Kconfig.sysbuild"
osource "/workspaces/unified-zmk-config-template/zephyr/soc/nxp/s32/Kconfig.sysbuild"
osource "/workspaces/unified-zmk-config-template/zephyr/soc/nxp/rw/Kconfig.sysbuild"
osource "/workspaces/unified-zmk-config-template/zephyr/soc/nxp/mcx/Kconfig.sysbuild"
osource "/workspaces/unified-zmk-config-template/zephyr/soc/nxp/lpc/Kconfig.sysbuild"
osource "/workspaces/unified-zmk-config-template/zephyr/soc/nxp/layerscape/Kconfig.sysbuild"
osource "/workspaces/unified-zmk-config-template/zephyr/soc/nxp/kinetis/Kconfig.sysbuild"
osource "/workspaces/unified-zmk-config-template/zephyr/soc/nxp/imxrt/Kconfig.sysbuild"
osource "/workspaces/unified-zmk-config-template/zephyr/soc/nxp/imx/Kconfig.sysbuild"
osource "/workspaces/unified-zmk-config-template/zephyr/soc/nuvoton/numicro/Kconfig.sysbuild"
osource "/workspaces/unified-zmk-config-template/zephyr/soc/nuvoton/numaker/Kconfig.sysbuild"
osource "/workspaces/unified-zmk-config-template/zephyr/soc/nuvoton/npcx/Kconfig.sysbuild"
osource "/workspaces/unified-zmk-config-template/zephyr/soc/nuvoton/npcm/Kconfig.sysbuild"
osource "/workspaces/unified-zmk-config-template/zephyr/soc/nordic/Kconfig.sysbuild"
osource "/workspaces/unified-zmk-config-template/zephyr/soc/neorv32/Kconfig.sysbuild"
osource "/workspaces/unified-zmk-config-template/zephyr/soc/native/inf_clock/Kconfig.sysbuild"
osource "/workspaces/unified-zmk-config-template/zephyr/soc/microchip/miv/Kconfig.sysbuild"
osource "/workspaces/unified-zmk-config-template/zephyr/soc/microchip/mec/Kconfig.sysbuild"
osource "/workspaces/unified-zmk-config-template/zephyr/soc/mediatek/mt8xxx/Kconfig.sysbuild"
osource "/workspaces/unified-zmk-config-template/zephyr/soc/lowrisc/opentitan/Kconfig.sysbuild"
osource "/workspaces/unified-zmk-config-template/zephyr/soc/litex/litex_vexriscv/Kconfig.sysbuild"
osource "/workspaces/unified-zmk-config-template/zephyr/soc/ite/ec/Kconfig.sysbuild"
osource "/workspaces/unified-zmk-config-template/zephyr/soc/intel/raptor_lake/Kconfig.sysbuild"
osource "/workspaces/unified-zmk-config-template/zephyr/soc/intel/lakemont/Kconfig.sysbuild"
osource "/workspaces/unified-zmk-config-template/zephyr/soc/intel/intel_socfpga_std/Kconfig.sysbuild"
osource "/workspaces/unified-zmk-config-template/zephyr/soc/intel/intel_socfpga/Kconfig.sysbuild"
osource "/workspaces/unified-zmk-config-template/zephyr/soc/intel/intel_niosv/Kconfig.sysbuild"
osource "/workspaces/unified-zmk-config-template/zephyr/soc/intel/intel_ish/Kconfig.sysbuild"
osource "/workspaces/unified-zmk-config-template/zephyr/soc/intel/intel_adsp/Kconfig.sysbuild"
osource "/workspaces/unified-zmk-config-template/zephyr/soc/intel/elkhart_lake/Kconfig.sysbuild"
osource "/workspaces/unified-zmk-config-template/zephyr/soc/intel/atom/Kconfig.sysbuild"
osource "/workspaces/unified-zmk-config-template/zephyr/soc/intel/apollo_lake/Kconfig.sysbuild"
osource "/workspaces/unified-zmk-config-template/zephyr/soc/intel/alder_lake/Kconfig.sysbuild"
osource "/workspaces/unified-zmk-config-template/zephyr/soc/infineon/cat3/Kconfig.sysbuild"
osource "/workspaces/unified-zmk-config-template/zephyr/soc/infineon/cat1b/Kconfig.sysbuild"
osource "/workspaces/unified-zmk-config-template/zephyr/soc/infineon/cat1a/Kconfig.sysbuild"
osource "/workspaces/unified-zmk-config-template/zephyr/soc/gd/gd32/Kconfig.sysbuild"
osource "/workspaces/unified-zmk-config-template/zephyr/soc/gaisler/leon3/Kconfig.sysbuild"
osource "/workspaces/unified-zmk-config-template/zephyr/soc/gaisler/gr716a/Kconfig.sysbuild"
osource "/workspaces/unified-zmk-config-template/zephyr/soc/espressif/Kconfig.sysbuild"
osource "/workspaces/unified-zmk-config-template/zephyr/soc/ene/kb1200/Kconfig.sysbuild"
osource "/workspaces/unified-zmk-config-template/zephyr/soc/efinix/sapphire/Kconfig.sysbuild"
osource "/workspaces/unified-zmk-config-template/zephyr/soc/cdns/xtensa_sample_controller/Kconfig.sysbuild"
osource "/workspaces/unified-zmk-config-template/zephyr/soc/cdns/sample_controller32/Kconfig.sysbuild"
osource "/workspaces/unified-zmk-config-template/zephyr/soc/cdns/dc233c/Kconfig.sysbuild"
osource "/workspaces/unified-zmk-config-template/zephyr/soc/brcm/bcmvk/Kconfig.sysbuild"
osource "/workspaces/unified-zmk-config-template/zephyr/soc/brcm/bcm2712/Kconfig.sysbuild"
osource "/workspaces/unified-zmk-config-template/zephyr/soc/brcm/bcm2711/Kconfig.sysbuild"
osource "/workspaces/unified-zmk-config-template/zephyr/soc/atmel/sam0/Kconfig.sysbuild"
osource "/workspaces/unified-zmk-config-template/zephyr/soc/atmel/sam/Kconfig.sysbuild"
osource "/workspaces/unified-zmk-config-template/zephyr/soc/aspeed/Kconfig.sysbuild"
osource "/workspaces/unified-zmk-config-template/zephyr/soc/arm/Kconfig.sysbuild"
osource "/workspaces/unified-zmk-config-template/zephyr/soc/arm/beetle/Kconfig.sysbuild"
osource "/workspaces/unified-zmk-config-template/zephyr/soc/antmicro/myra/Kconfig.sysbuild"
osource "/workspaces/unified-zmk-config-template/zephyr/soc/andestech/Kconfig.sysbuild"
osource "/workspaces/unified-zmk-config-template/zephyr/soc/amd/acp_6_0/Kconfig.sysbuild"
osource "/workspaces/unified-zmk-config-template/zephyr/soc/ambiq/Kconfig.sysbuild"
osource "/workspaces/unified-zmk-config-template/zephyr/soc/altr/zephyr_nios2f/Kconfig.sysbuild"
osource "/workspaces/unified-zmk-config-template/zephyr/soc/altr/qemu_nios2/Kconfig.sysbuild"
osource "/workspaces/unified-zmk-config-template/zephyr/soc/adi/max32/Kconfig.sysbuild"
```

## config/boards/shields/paw3395/Kconfig.defconfig
```kconfig
if SHIELD_PAW3395

config ZMK_POINTING
    default y

config SPI
    default y

config ZMK_USB
    default y

config ZMK_BLE
    default y

config PAW3395_NEOPIXEL_POWER
    bool "Enable LED power control delay"
    default y
    help
      Enable 2-second delay before powering on LEDs via SWCLK pin.
      Required for this hardware design.

endif
```

## config/west.yml
```yaml
manifest:
  defaults:
    remote: zmkfirmware
  
  remotes:
    - name: zmkfirmware
      url-base: https://github.com/zmkfirmware
    - name: badjeff
      url-base: https://github.com/badjeff

  projects:
    - name: zmk
      remote: zmkfirmware
      revision: main
      import: app/west.yml
    - name: zmk-paw3395-driver
      remote: badjeff
      revision: main
      path: zmk-paw3395-driver
  
  self:
    path: config
```
