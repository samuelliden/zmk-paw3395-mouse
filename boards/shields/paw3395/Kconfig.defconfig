## boards/shields/paw3395/Kconfig.defconfig
```kconfig
if SHIELD_PAW3395

config PAW3395
    default y

config INPUT
    default y

config ZMK_POINTING
    default y

config SPI
    default y

config ZMK_USB
    default y

config ZMK_BLE
    default y

config ZMK_MOUSE
    default y

config ZMK_HID_MOUSE
    default y

config ZMK_RGB_UNDERGLOW
    default y

config WS2812_STRIP
    default y

config LED_STRIP
    default y

config EC11
    default y

endif
```

## build/paw3395_test/Kconfig/Kconfig.modules
```kconfig
menu "zmk-paw3395-driver (/workspaces/unified-zmk-config-template/zmk-paw3395-driver)"
osource "/workspaces/unified-zmk-config-template/zmk-paw3395-driver/Kconfig"
config ZEPHYR_ZMK_PAW3395_DRIVER_MODULE
	bool
	default y
endmenu
config ZEPHYR_ZMK_PAW3395_MOUSE_MODULE
	bool
	default y
menu "lvgl (/workspaces/unified-zmk-config-template/modules/lib/gui/lvgl)"
osource "/workspaces/unified-zmk-config-template/modules/lib/gui/lvgl/zephyr/Kconfig"
config ZEPHYR_LVGL_MODULE
	bool
	default y
endmenu
config ZEPHYR_ZMK_STUDIO_MESSAGES_MODULE
	bool
	default y
menu "canopennode (/workspaces/unified-zmk-config-template/modules/lib/canopennode)"
osource "$(ZEPHYR_CANOPENNODE_KCONFIG)"
config ZEPHYR_CANOPENNODE_MODULE
	bool
	default y
endmenu
menu "chre (/workspaces/unified-zmk-config-template/modules/lib/chre)"
osource "/workspaces/unified-zmk-config-template/modules/lib/chre/platform/zephyr/Kconfig"
config ZEPHYR_CHRE_MODULE
	bool
	default y
endmenu
menu "lz4 (/workspaces/unified-zmk-config-template/modules/lib/lz4)"
osource "$(ZEPHYR_LZ4_KCONFIG)"
config ZEPHYR_LZ4_MODULE
	bool
	default y
endmenu
menu "nanopb (/workspaces/unified-zmk-config-template/modules/lib/nanopb)"
osource "$(ZEPHYR_NANOPB_KCONFIG)"
config ZEPHYR_NANOPB_MODULE
	bool
	default y
endmenu
config ZEPHYR_PSA_ARCH_TESTS_MODULE
	bool
	default y
menu "sof (/workspaces/unified-zmk-config-template/modules/audio/sof)"
osource "/workspaces/unified-zmk-config-template/modules/audio/sof/zephyr/Kconfig"
config ZEPHYR_SOF_MODULE
	bool
	default y
endmenu
config ZEPHYR_TF_M_TESTS_MODULE
	bool
	default y
menu "tflite-micro (/workspaces/unified-zmk-config-template/optional/modules/lib/tflite-micro)"
osource "$(ZEPHYR_TFLITE_MICRO_KCONFIG)"
config ZEPHYR_TFLITE_MICRO_MODULE
	bool
	default y
endmenu
menu "thrift (/workspaces/unified-zmk-config-template/optional/modules/lib/thrift)"
osource "$(ZEPHYR_THRIFT_KCONFIG)"
config ZEPHYR_THRIFT_MODULE
	bool
	default y
endmenu
menu "lang-rust (/workspaces/unified-zmk-config-template/modules/lang/rust)"
osource "/workspaces/unified-zmk-config-template/modules/lang/rust/Kconfig"
config ZEPHYR_LANG_RUST_MODULE
	bool
	default y
endmenu
menu "zscilib (/workspaces/unified-zmk-config-template/modules/lib/zscilib)"
osource "/workspaces/unified-zmk-config-template/modules/lib/zscilib/Kconfig.zscilib"
config ZEPHYR_ZSCILIB_MODULE
	bool
	default y
endmenu
menu "acpica (/workspaces/unified-zmk-config-template/modules/lib/acpica)"
osource "$(ZEPHYR_ACPICA_KCONFIG)"
config ZEPHYR_ACPICA_MODULE
	bool
	default y
endmenu
menu "cmsis (/workspaces/unified-zmk-config-template/modules/hal/cmsis)"
osource "$(ZEPHYR_CMSIS_KCONFIG)"
config ZEPHYR_CMSIS_MODULE
	bool
	default y
endmenu
menu "cmsis-dsp (/workspaces/unified-zmk-config-template/modules/lib/cmsis-dsp)"
osource "$(ZEPHYR_CMSIS_DSP_KCONFIG)"
config ZEPHYR_CMSIS_DSP_MODULE
	bool
	default y
endmenu
menu "cmsis-nn (/workspaces/unified-zmk-config-template/modules/lib/cmsis-nn)"
osource "$(ZEPHYR_CMSIS_NN_KCONFIG)"
config ZEPHYR_CMSIS_NN_MODULE
	bool
	default y
endmenu
menu "fatfs (/workspaces/unified-zmk-config-template/modules/fs/fatfs)"
osource "$(ZEPHYR_FATFS_KCONFIG)"
config ZEPHYR_FATFS_MODULE
	bool
	default y
endmenu
config ZEPHYR_ADI_MODULE
	bool
	default y
menu "hal_ambiq (/workspaces/unified-zmk-config-template/modules/hal/ambiq)"
osource "$(ZEPHYR_HAL_AMBIQ_KCONFIG)"
config ZEPHYR_HAL_AMBIQ_MODULE
	bool
	default y
endmenu
config ZEPHYR_ATMEL_MODULE
	bool
	default y
menu "hal_espressif (/workspaces/unified-zmk-config-template/modules/hal/espressif)"
osource "/workspaces/unified-zmk-config-template/modules/hal/espressif/zephyr/Kconfig"
config ZEPHYR_HAL_ESPRESSIF_MODULE
	bool
	default y

config ZEPHYR_HAL_ESPRESSIF_MODULE_BLOBS
	bool
endmenu
menu "hal_ethos_u (/workspaces/unified-zmk-config-template/modules/hal/ethos_u)"
osource "$(ZEPHYR_HAL_ETHOS_U_KCONFIG)"
config ZEPHYR_HAL_ETHOS_U_MODULE
	bool
	default y
endmenu
menu "hal_gigadevice (/workspaces/unified-zmk-config-template/modules/hal/gigadevice)"
osource "$(ZEPHYR_HAL_GIGADEVICE_KCONFIG)"
config ZEPHYR_HAL_GIGADEVICE_MODULE
	bool
	default y
endmenu
menu "hal_intel (/workspaces/unified-zmk-config-template/modules/hal/intel)"
osource "/workspaces/unified-zmk-config-template/modules/hal/intel/zephyr/Kconfig"
config ZEPHYR_HAL_INTEL_MODULE
	bool
	default y
endmenu
menu "hal_nordic (/workspaces/unified-zmk-config-template/modules/hal/nordic)"
osource "$(ZEPHYR_HAL_NORDIC_KCONFIG)"
config ZEPHYR_HAL_NORDIC_MODULE
	bool
	default y

config ZEPHYR_HAL_NORDIC_MODULE_BLOBS
	bool
endmenu
config ZEPHYR_NUVOTON_MODULE
	bool
	default y
config ZEPHYR_QUICKLOGIC_MODULE
	bool
	default y
config ZEPHYR_HAL_RENESAS_MODULE
	bool
	default y

config ZEPHYR_HAL_RENESAS_MODULE_BLOBS
	bool
menu "hal_rpi_pico (/workspaces/unified-zmk-config-template/modules/hal/rpi_pico)"
osource "$(ZEPHYR_HAL_RPI_PICO_KCONFIG)"
config ZEPHYR_HAL_RPI_PICO_MODULE
	bool
	default y
endmenu
menu "hal_silabs (/workspaces/unified-zmk-config-template/modules/hal/silabs)"
osource "$(ZEPHYR_HAL_SILABS_KCONFIG)"
config ZEPHYR_HAL_SILABS_MODULE
	bool
	default y

config ZEPHYR_HAL_SILABS_MODULE_BLOBS
	bool
endmenu
config ZEPHYR_HAL_STM32_MODULE
	bool
	default y

config ZEPHYR_HAL_STM32_MODULE_BLOBS
	bool
menu "hal_tdk (/workspaces/unified-zmk-config-template/modules/hal/tdk)"
osource "$(ZEPHYR_HAL_TDK_KCONFIG)"
config ZEPHYR_HAL_TDK_MODULE
	bool
	default y
endmenu
menu "hal_telink (/workspaces/unified-zmk-config-template/modules/hal/telink)"
osource "/workspaces/unified-zmk-config-template/modules/hal/telink/Kconfig"
config ZEPHYR_HAL_TELINK_MODULE
	bool
	default y
endmenu
menu "hal_wch (/workspaces/unified-zmk-config-template/modules/hal/wch)"
osource "$(ZEPHYR_HAL_WCH_KCONFIG)"
config ZEPHYR_HAL_WCH_MODULE
	bool
	default y
endmenu
config ZEPHYR_HAL_WURTHELEKTRONIK_MODULE
	bool
	default y
menu "hostap (/workspaces/unified-zmk-config-template/modules/lib/hostap)"
osource "$(ZEPHYR_HOSTAP_KCONFIG)"
config ZEPHYR_HOSTAP_MODULE
	bool
	default y
endmenu
menu "liblc3 (/workspaces/unified-zmk-config-template/modules/lib/liblc3)"
osource "$(ZEPHYR_LIBLC3_KCONFIG)"
config ZEPHYR_LIBLC3_MODULE
	bool
	default y
endmenu
config ZEPHYR_LIBMCTP_MODULE
	bool
	default y
config ZEPHYR_LIBMETAL_MODULE
	bool
	default y
menu "littlefs (/workspaces/unified-zmk-config-template/modules/fs/littlefs)"
osource "$(ZEPHYR_LITTLEFS_KCONFIG)"
config ZEPHYR_LITTLEFS_MODULE
	bool
	default y
endmenu
menu "mbedtls (/workspaces/unified-zmk-config-template/modules/crypto/mbedtls)"
osource "$(ZEPHYR_MBEDTLS_KCONFIG)"
config ZEPHYR_MBEDTLS_MODULE
	bool
	default y
endmenu
config ZEPHYR_MIPI_SYS_T_MODULE
	bool
	default y
menu "nrf_wifi (/workspaces/unified-zmk-config-template/modules/lib/nrf_wifi)"
osource "$(ZEPHYR_NRF_WIFI_KCONFIG)"
config ZEPHYR_NRF_WIFI_MODULE
	bool
	default y

config ZEPHYR_NRF_WIFI_MODULE_BLOBS
	bool
endmenu
config ZEPHYR_OPEN_AMP_MODULE
	bool
	default y
menu "percepio (/workspaces/unified-zmk-config-template/modules/debug/percepio)"
osource "/workspaces/unified-zmk-config-template/modules/debug/percepio/zephyr/Kconfig"
config ZEPHYR_PERCEPIO_MODULE
	bool
	default y
endmenu
menu "picolibc (/workspaces/unified-zmk-config-template/modules/lib/picolibc)"
osource "/workspaces/unified-zmk-config-template/modules/lib/picolibc/zephyr/Kconfig"
config ZEPHYR_PICOLIBC_MODULE
	bool
	default y
endmenu
menu "segger (/workspaces/unified-zmk-config-template/modules/debug/segger)"
osource "$(ZEPHYR_SEGGER_KCONFIG)"
config ZEPHYR_SEGGER_MODULE
	bool
	default y
endmenu
config ZEPHYR_TINYCRYPT_MODULE
	bool
	default y
menu "trusted-firmware-a (/workspaces/unified-zmk-config-template/modules/tee/tf-a/trusted-firmware-a)"
osource "$(ZEPHYR_TRUSTED_FIRMWARE_A_KCONFIG)"
config ZEPHYR_TRUSTED_FIRMWARE_A_MODULE
	bool
	default y
endmenu
menu "uoscore-uedhoc (/workspaces/unified-zmk-config-template/modules/lib/uoscore-uedhoc)"
osource "$(ZEPHYR_UOSCORE_UEDHOC_KCONFIG)"
config ZEPHYR_UOSCORE_UEDHOC_MODULE
	bool
	default y
endmenu
menu "zcbor (/workspaces/unified-zmk-config-template/modules/lib/zcbor)"
osource "$(ZEPHYR_ZCBOR_KCONFIG)"
config ZEPHYR_ZCBOR_MODULE
	bool
	default y
endmenu
menu "module (/workspaces/unified-zmk-config-template/zmk/app/module)"
osource "/workspaces/unified-zmk-config-template/zmk/app/module/Kconfig"
config ZEPHYR_MODULE_MODULE
	bool
	default y
endmenu
config ZEPHYR_KEYMAP_MODULE_MODULE
	bool
	default y
config ZEPHYR_NRF_HW_MODELS_MODULE
	bool
	default y
```

## build/paw3395_test/Kconfig/Kconfig.shield
```kconfig
osource "/workspaces/unified-zmk-config-template/zmk-paw3395-mouse/boards/shields/*/Kconfig.shield"
osource "/workspaces/unified-zmk-config-template/zmk/app/boards/shields/*/Kconfig.shield"
```

## build/paw3395_test/Kconfig/Kconfig.shield.defconfig
```kconfig
osource "/workspaces/unified-zmk-config-template/zmk-paw3395-mouse/boards/shields/*/Kconfig.defconfig"
osource "/workspaces/unified-zmk-config-template/zmk/app/boards/shields/*/Kconfig.defconfig"
```

## build/paw3395_test/Kconfig/arch/Kconfig
```kconfig
# Load Zephyr Arch Kconfig descriptions.
osource "/workspaces/unified-zmk-config-template/zephyr/arch/x86/Kconfig"
osource "/workspaces/unified-zmk-config-template/zephyr/arch/xtensa/Kconfig"
osource "/workspaces/unified-zmk-config-template/zephyr/arch/sparc/Kconfig"
osource "/workspaces/unified-zmk-config-template/zephyr/arch/riscv/Kconfig"
osource "/workspaces/unified-zmk-config-template/zephyr/arch/posix/Kconfig"
osource "/workspaces/unified-zmk-config-template/zephyr/arch/nios2/Kconfig"
osource "/workspaces/unified-zmk-config-template/zephyr/arch/mips/Kconfig"
osource "/workspaces/unified-zmk-config-template/zephyr/arch/arm64/Kconfig"
osource "/workspaces/unified-zmk-config-template/zephyr/arch/arm/Kconfig"
osource "/workspaces/unified-zmk-config-template/zephyr/arch/arc/Kconfig"
```

## build/paw3395_test/Kconfig/boards/Kconfig
```kconfig
# Load Zephyr board Kconfig descriptions.
osource "/workspaces/unified-zmk-config-template/zephyr/boards/seeed/xiao_ble/Kconfig"
```

## build/paw3395_test/Kconfig/boards/Kconfig.defconfig
```kconfig
# Load Zephyr board defconfig descriptions.
osource "/workspaces/unified-zmk-config-template/zephyr/boards/seeed/xiao_ble/Kconfig.defconfig"
```

## build/paw3395_test/Kconfig/boards/Kconfig.xiao_ble
```kconfig
# Load board Kconfig descriptions.
osource "/workspaces/unified-zmk-config-template/zephyr/boards/seeed/xiao_ble/Kconfig.xiao_ble"
```
