## build/paw3395_test/Kconfig/soc/Kconfig.soc
```kconfig
# Load SoC Kconfig descriptions.
osource "/workspaces/unified-zmk-config-template/zephyr/soc/xlnx/zynqmp/Kconfig.soc"
osource "/workspaces/unified-zmk-config-template/zephyr/soc/xlnx/zynq7000/Kconfig.soc"
osource "/workspaces/unified-zmk-config-template/zephyr/soc/xen/Kconfig.soc"
osource "/workspaces/unified-zmk-config-template/zephyr/soc/wch/ch32v/Kconfig.soc"
osource "/workspaces/unified-zmk-config-template/zephyr/soc/ti/simplelink/Kconfig.soc"
osource "/workspaces/unified-zmk-config-template/zephyr/soc/ti/lm3s6965/Kconfig.soc"
osource "/workspaces/unified-zmk-config-template/zephyr/soc/ti/k3/Kconfig.soc"
osource "/workspaces/unified-zmk-config-template/zephyr/soc/telink/tlsr/Kconfig.soc"
osource "/workspaces/unified-zmk-config-template/zephyr/soc/starfive/jh71xx/Kconfig.soc"
osource "/workspaces/unified-zmk-config-template/zephyr/soc/st/stm32/Kconfig.soc"
osource "/workspaces/unified-zmk-config-template/zephyr/soc/snps/qemu_arc/Kconfig.soc"
osource "/workspaces/unified-zmk-config-template/zephyr/soc/snps/nsim/arc_v/Kconfig.soc"
osource "/workspaces/unified-zmk-config-template/zephyr/soc/snps/nsim/arc_classic/Kconfig.soc"
osource "/workspaces/unified-zmk-config-template/zephyr/soc/snps/hsdk4xd/Kconfig.soc"
osource "/workspaces/unified-zmk-config-template/zephyr/soc/snps/hsdk/Kconfig.soc"
osource "/workspaces/unified-zmk-config-template/zephyr/soc/snps/emsk/Kconfig.soc"
osource "/workspaces/unified-zmk-config-template/zephyr/soc/snps/emsdp/Kconfig.soc"
osource "/workspaces/unified-zmk-config-template/zephyr/soc/snps/arc_iot/Kconfig.soc"
osource "/workspaces/unified-zmk-config-template/zephyr/soc/silabs/Kconfig.soc"
osource "/workspaces/unified-zmk-config-template/zephyr/soc/sifive/sifive_freedom/Kconfig.soc"
osource "/workspaces/unified-zmk-config-template/zephyr/soc/sensry/Kconfig.soc"
osource "/workspaces/unified-zmk-config-template/zephyr/soc/rockchip/Kconfig.soc"
osource "/workspaces/unified-zmk-config-template/zephyr/soc/renode/riscv_virtual/Kconfig.soc"
osource "/workspaces/unified-zmk-config-template/zephyr/soc/renode/cortex_r8_virtual/Kconfig.soc"
osource "/workspaces/unified-zmk-config-template/zephyr/soc/renesas/smartbond/Kconfig.soc"
osource "/workspaces/unified-zmk-config-template/zephyr/soc/renesas/rzt2m/Kconfig.soc"
osource "/workspaces/unified-zmk-config-template/zephyr/soc/renesas/rz/Kconfig.soc"
osource "/workspaces/unified-zmk-config-template/zephyr/soc/renesas/rcar/Kconfig.soc"
osource "/workspaces/unified-zmk-config-template/zephyr/soc/renesas/ra/Kconfig.soc"
osource "/workspaces/unified-zmk-config-template/zephyr/soc/realtek/ec/Kconfig.soc"
osource "/workspaces/unified-zmk-config-template/zephyr/soc/raspberrypi/rpi_pico/Kconfig.soc"
osource "/workspaces/unified-zmk-config-template/zephyr/soc/quicklogic/eos_s3/Kconfig.soc"
osource "/workspaces/unified-zmk-config-template/zephyr/soc/qemu/virt_riscv/Kconfig.soc"
osource "/workspaces/unified-zmk-config-template/zephyr/soc/qemu/malta/Kconfig.soc"
osource "/workspaces/unified-zmk-config-template/zephyr/soc/openisa/rv32m1/Kconfig.soc"
osource "/workspaces/unified-zmk-config-template/zephyr/soc/nxp/s32/Kconfig.soc"
osource "/workspaces/unified-zmk-config-template/zephyr/soc/nxp/rw/Kconfig.soc"
osource "/workspaces/unified-zmk-config-template/zephyr/soc/nxp/mcx/Kconfig.soc"
osource "/workspaces/unified-zmk-config-template/zephyr/soc/nxp/lpc/Kconfig.soc"
osource "/workspaces/unified-zmk-config-template/zephyr/soc/nxp/layerscape/Kconfig.soc"
osource "/workspaces/unified-zmk-config-template/zephyr/soc/nxp/kinetis/Kconfig.soc"
osource "/workspaces/unified-zmk-config-template/zephyr/soc/nxp/imxrt/Kconfig.soc"
osource "/workspaces/unified-zmk-config-template/zephyr/soc/nxp/imx/Kconfig.soc"
osource "/workspaces/unified-zmk-config-template/zephyr/soc/nuvoton/numicro/Kconfig.soc"
osource "/workspaces/unified-zmk-config-template/zephyr/soc/nuvoton/numaker/Kconfig.soc"
osource "/workspaces/unified-zmk-config-template/zephyr/soc/nuvoton/npcx/Kconfig.soc"
osource "/workspaces/unified-zmk-config-template/zephyr/soc/nuvoton/npcm/Kconfig.soc"
osource "/workspaces/unified-zmk-config-template/zephyr/soc/nordic/Kconfig.soc"
osource "/workspaces/unified-zmk-config-template/zephyr/soc/neorv32/Kconfig.soc"
osource "/workspaces/unified-zmk-config-template/zephyr/soc/native/inf_clock/Kconfig.soc"
osource "/workspaces/unified-zmk-config-template/zephyr/soc/microchip/miv/Kconfig.soc"
osource "/workspaces/unified-zmk-config-template/zephyr/soc/microchip/mec/Kconfig.soc"
osource "/workspaces/unified-zmk-config-template/zephyr/soc/mediatek/mt8xxx/Kconfig.soc"
osource "/workspaces/unified-zmk-config-template/zephyr/soc/lowrisc/opentitan/Kconfig.soc"
osource "/workspaces/unified-zmk-config-template/zephyr/soc/litex/litex_vexriscv/Kconfig.soc"
osource "/workspaces/unified-zmk-config-template/zephyr/soc/ite/ec/Kconfig.soc"
osource "/workspaces/unified-zmk-config-template/zephyr/soc/intel/raptor_lake/Kconfig.soc"
osource "/workspaces/unified-zmk-config-template/zephyr/soc/intel/lakemont/Kconfig.soc"
osource "/workspaces/unified-zmk-config-template/zephyr/soc/intel/intel_socfpga_std/Kconfig.soc"
osource "/workspaces/unified-zmk-config-template/zephyr/soc/intel/intel_socfpga/Kconfig.soc"
osource "/workspaces/unified-zmk-config-template/zephyr/soc/intel/intel_niosv/Kconfig.soc"
osource "/workspaces/unified-zmk-config-template/zephyr/soc/intel/intel_ish/Kconfig.soc"
osource "/workspaces/unified-zmk-config-template/zephyr/soc/intel/intel_adsp/Kconfig.soc"
osource "/workspaces/unified-zmk-config-template/zephyr/soc/intel/elkhart_lake/Kconfig.soc"
osource "/workspaces/unified-zmk-config-template/zephyr/soc/intel/atom/Kconfig.soc"
osource "/workspaces/unified-zmk-config-template/zephyr/soc/intel/apollo_lake/Kconfig.soc"
osource "/workspaces/unified-zmk-config-template/zephyr/soc/intel/alder_lake/Kconfig.soc"
osource "/workspaces/unified-zmk-config-template/zephyr/soc/infineon/cat3/Kconfig.soc"
osource "/workspaces/unified-zmk-config-template/zephyr/soc/infineon/cat1b/Kconfig.soc"
osource "/workspaces/unified-zmk-config-template/zephyr/soc/infineon/cat1a/Kconfig.soc"
osource "/workspaces/unified-zmk-config-template/zephyr/soc/gd/gd32/Kconfig.soc"
osource "/workspaces/unified-zmk-config-template/zephyr/soc/gaisler/leon3/Kconfig.soc"
osource "/workspaces/unified-zmk-config-template/zephyr/soc/gaisler/gr716a/Kconfig.soc"
osource "/workspaces/unified-zmk-config-template/zephyr/soc/espressif/Kconfig.soc"
osource "/workspaces/unified-zmk-config-template/zephyr/soc/ene/kb1200/Kconfig.soc"
osource "/workspaces/unified-zmk-config-template/zephyr/soc/efinix/sapphire/Kconfig.soc"
osource "/workspaces/unified-zmk-config-template/zephyr/soc/cdns/xtensa_sample_controller/Kconfig.soc"
osource "/workspaces/unified-zmk-config-template/zephyr/soc/cdns/sample_controller32/Kconfig.soc"
osource "/workspaces/unified-zmk-config-template/zephyr/soc/cdns/dc233c/Kconfig.soc"
osource "/workspaces/unified-zmk-config-template/zephyr/soc/brcm/bcmvk/Kconfig.soc"
osource "/workspaces/unified-zmk-config-template/zephyr/soc/brcm/bcm2712/Kconfig.soc"
osource "/workspaces/unified-zmk-config-template/zephyr/soc/brcm/bcm2711/Kconfig.soc"
osource "/workspaces/unified-zmk-config-template/zephyr/soc/atmel/sam0/Kconfig.soc"
osource "/workspaces/unified-zmk-config-template/zephyr/soc/atmel/sam/Kconfig.soc"
osource "/workspaces/unified-zmk-config-template/zephyr/soc/aspeed/Kconfig.soc"
osource "/workspaces/unified-zmk-config-template/zephyr/soc/arm/Kconfig.soc"
osource "/workspaces/unified-zmk-config-template/zephyr/soc/arm/beetle/Kconfig.soc"
osource "/workspaces/unified-zmk-config-template/zephyr/soc/antmicro/myra/Kconfig.soc"
osource "/workspaces/unified-zmk-config-template/zephyr/soc/andestech/Kconfig.soc"
osource "/workspaces/unified-zmk-config-template/zephyr/soc/amd/acp_6_0/Kconfig.soc"
osource "/workspaces/unified-zmk-config-template/zephyr/soc/ambiq/Kconfig.soc"
osource "/workspaces/unified-zmk-config-template/zephyr/soc/altr/zephyr_nios2f/Kconfig.soc"
osource "/workspaces/unified-zmk-config-template/zephyr/soc/altr/qemu_nios2/Kconfig.soc"
osource "/workspaces/unified-zmk-config-template/zephyr/soc/adi/max32/Kconfig.soc"
```
