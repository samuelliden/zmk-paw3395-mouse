## build/paw3395_test/Kconfig/soc/Kconfig
```kconfig
# Load Zephyr SoC Kconfig descriptions.
osource "/workspaces/unified-zmk-config-template/zephyr/soc/xlnx/zynqmp/Kconfig"
osource "/workspaces/unified-zmk-config-template/zephyr/soc/xlnx/zynq7000/Kconfig"
osource "/workspaces/unified-zmk-config-template/zephyr/soc/xen/Kconfig"
osource "/workspaces/unified-zmk-config-template/zephyr/soc/wch/ch32v/Kconfig"
osource "/workspaces/unified-zmk-config-template/zephyr/soc/ti/simplelink/Kconfig"
osource "/workspaces/unified-zmk-config-template/zephyr/soc/ti/lm3s6965/Kconfig"
osource "/workspaces/unified-zmk-config-template/zephyr/soc/ti/k3/Kconfig"
osource "/workspaces/unified-zmk-config-template/zephyr/soc/telink/tlsr/Kconfig"
osource "/workspaces/unified-zmk-config-template/zephyr/soc/starfive/jh71xx/Kconfig"
osource "/workspaces/unified-zmk-config-template/zephyr/soc/st/stm32/Kconfig"
osource "/workspaces/unified-zmk-config-template/zephyr/soc/snps/qemu_arc/Kconfig"
osource "/workspaces/unified-zmk-config-template/zephyr/soc/snps/nsim/arc_v/Kconfig"
osource "/workspaces/unified-zmk-config-template/zephyr/soc/snps/nsim/arc_classic/Kconfig"
osource "/workspaces/unified-zmk-config-template/zephyr/soc/snps/hsdk4xd/Kconfig"
osource "/workspaces/unified-zmk-config-template/zephyr/soc/snps/hsdk/Kconfig"
osource "/workspaces/unified-zmk-config-template/zephyr/soc/snps/emsk/Kconfig"
osource "/workspaces/unified-zmk-config-template/zephyr/soc/snps/emsdp/Kconfig"
osource "/workspaces/unified-zmk-config-template/zephyr/soc/snps/arc_iot/Kconfig"
osource "/workspaces/unified-zmk-config-template/zephyr/soc/silabs/Kconfig"
osource "/workspaces/unified-zmk-config-template/zephyr/soc/sifive/sifive_freedom/Kconfig"
osource "/workspaces/unified-zmk-config-template/zephyr/soc/sensry/Kconfig"
osource "/workspaces/unified-zmk-config-template/zephyr/soc/rockchip/Kconfig"
osource "/workspaces/unified-zmk-config-template/zephyr/soc/renode/riscv_virtual/Kconfig"
osource "/workspaces/unified-zmk-config-template/zephyr/soc/renode/cortex_r8_virtual/Kconfig"
osource "/workspaces/unified-zmk-config-template/zephyr/soc/renesas/smartbond/Kconfig"
osource "/workspaces/unified-zmk-config-template/zephyr/soc/renesas/rzt2m/Kconfig"
osource "/workspaces/unified-zmk-config-template/zephyr/soc/renesas/rz/Kconfig"
osource "/workspaces/unified-zmk-config-template/zephyr/soc/renesas/rcar/Kconfig"
osource "/workspaces/unified-zmk-config-template/zephyr/soc/renesas/ra/Kconfig"
osource "/workspaces/unified-zmk-config-template/zephyr/soc/realtek/ec/Kconfig"
osource "/workspaces/unified-zmk-config-template/zephyr/soc/raspberrypi/rpi_pico/Kconfig"
osource "/workspaces/unified-zmk-config-template/zephyr/soc/quicklogic/eos_s3/Kconfig"
osource "/workspaces/unified-zmk-config-template/zephyr/soc/qemu/virt_riscv/Kconfig"
osource "/workspaces/unified-zmk-config-template/zephyr/soc/qemu/malta/Kconfig"
osource "/workspaces/unified-zmk-config-template/zephyr/soc/openisa/rv32m1/Kconfig"
osource "/workspaces/unified-zmk-config-template/zephyr/soc/nxp/s32/Kconfig"
osource "/workspaces/unified-zmk-config-template/zephyr/soc/nxp/rw/Kconfig"
osource "/workspaces/unified-zmk-config-template/zephyr/soc/nxp/mcx/Kconfig"
osource "/workspaces/unified-zmk-config-template/zephyr/soc/nxp/lpc/Kconfig"
osource "/workspaces/unified-zmk-config-template/zephyr/soc/nxp/layerscape/Kconfig"
osource "/workspaces/unified-zmk-config-template/zephyr/soc/nxp/kinetis/Kconfig"
osource "/workspaces/unified-zmk-config-template/zephyr/soc/nxp/imxrt/Kconfig"
osource "/workspaces/unified-zmk-config-template/zephyr/soc/nxp/imx/Kconfig"
osource "/workspaces/unified-zmk-config-template/zephyr/soc/nuvoton/numicro/Kconfig"
osource "/workspaces/unified-zmk-config-template/zephyr/soc/nuvoton/numaker/Kconfig"
osource "/workspaces/unified-zmk-config-template/zephyr/soc/nuvoton/npcx/Kconfig"
osource "/workspaces/unified-zmk-config-template/zephyr/soc/nuvoton/npcm/Kconfig"
osource "/workspaces/unified-zmk-config-template/zephyr/soc/nordic/Kconfig"
osource "/workspaces/unified-zmk-config-template/zephyr/soc/neorv32/Kconfig"
osource "/workspaces/unified-zmk-config-template/zephyr/soc/native/inf_clock/Kconfig"
osource "/workspaces/unified-zmk-config-template/zephyr/soc/microchip/miv/Kconfig"
osource "/workspaces/unified-zmk-config-template/zephyr/soc/microchip/mec/Kconfig"
osource "/workspaces/unified-zmk-config-template/zephyr/soc/mediatek/mt8xxx/Kconfig"
osource "/workspaces/unified-zmk-config-template/zephyr/soc/lowrisc/opentitan/Kconfig"
osource "/workspaces/unified-zmk-config-template/zephyr/soc/litex/litex_vexriscv/Kconfig"
osource "/workspaces/unified-zmk-config-template/zephyr/soc/ite/ec/Kconfig"
osource "/workspaces/unified-zmk-config-template/zephyr/soc/intel/raptor_lake/Kconfig"
osource "/workspaces/unified-zmk-config-template/zephyr/soc/intel/lakemont/Kconfig"
osource "/workspaces/unified-zmk-config-template/zephyr/soc/intel/intel_socfpga_std/Kconfig"
osource "/workspaces/unified-zmk-config-template/zephyr/soc/intel/intel_socfpga/Kconfig"
osource "/workspaces/unified-zmk-config-template/zephyr/soc/intel/intel_niosv/Kconfig"
osource "/workspaces/unified-zmk-config-template/zephyr/soc/intel/intel_ish/Kconfig"
osource "/workspaces/unified-zmk-config-template/zephyr/soc/intel/intel_adsp/Kconfig"
osource "/workspaces/unified-zmk-config-template/zephyr/soc/intel/elkhart_lake/Kconfig"
osource "/workspaces/unified-zmk-config-template/zephyr/soc/intel/atom/Kconfig"
osource "/workspaces/unified-zmk-config-template/zephyr/soc/intel/apollo_lake/Kconfig"
osource "/workspaces/unified-zmk-config-template/zephyr/soc/intel/alder_lake/Kconfig"
osource "/workspaces/unified-zmk-config-template/zephyr/soc/infineon/cat3/Kconfig"
osource "/workspaces/unified-zmk-config-template/zephyr/soc/infineon/cat1b/Kconfig"
osource "/workspaces/unified-zmk-config-template/zephyr/soc/infineon/cat1a/Kconfig"
osource "/workspaces/unified-zmk-config-template/zephyr/soc/gd/gd32/Kconfig"
osource "/workspaces/unified-zmk-config-template/zephyr/soc/gaisler/leon3/Kconfig"
osource "/workspaces/unified-zmk-config-template/zephyr/soc/gaisler/gr716a/Kconfig"
osource "/workspaces/unified-zmk-config-template/zephyr/soc/espressif/Kconfig"
osource "/workspaces/unified-zmk-config-template/zephyr/soc/ene/kb1200/Kconfig"
osource "/workspaces/unified-zmk-config-template/zephyr/soc/efinix/sapphire/Kconfig"
osource "/workspaces/unified-zmk-config-template/zephyr/soc/cdns/xtensa_sample_controller/Kconfig"
osource "/workspaces/unified-zmk-config-template/zephyr/soc/cdns/sample_controller32/Kconfig"
osource "/workspaces/unified-zmk-config-template/zephyr/soc/cdns/dc233c/Kconfig"
osource "/workspaces/unified-zmk-config-template/zephyr/soc/brcm/bcmvk/Kconfig"
osource "/workspaces/unified-zmk-config-template/zephyr/soc/brcm/bcm2712/Kconfig"
osource "/workspaces/unified-zmk-config-template/zephyr/soc/brcm/bcm2711/Kconfig"
osource "/workspaces/unified-zmk-config-template/zephyr/soc/atmel/sam0/Kconfig"
osource "/workspaces/unified-zmk-config-template/zephyr/soc/atmel/sam/Kconfig"
osource "/workspaces/unified-zmk-config-template/zephyr/soc/aspeed/Kconfig"
osource "/workspaces/unified-zmk-config-template/zephyr/soc/arm/Kconfig"
osource "/workspaces/unified-zmk-config-template/zephyr/soc/arm/beetle/Kconfig"
osource "/workspaces/unified-zmk-config-template/zephyr/soc/antmicro/myra/Kconfig"
osource "/workspaces/unified-zmk-config-template/zephyr/soc/andestech/Kconfig"
osource "/workspaces/unified-zmk-config-template/zephyr/soc/amd/acp_6_0/Kconfig"
osource "/workspaces/unified-zmk-config-template/zephyr/soc/ambiq/Kconfig"
osource "/workspaces/unified-zmk-config-template/zephyr/soc/altr/zephyr_nios2f/Kconfig"
osource "/workspaces/unified-zmk-config-template/zephyr/soc/altr/qemu_nios2/Kconfig"
osource "/workspaces/unified-zmk-config-template/zephyr/soc/adi/max32/Kconfig"
```
