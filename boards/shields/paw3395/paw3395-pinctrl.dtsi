// SPDX-License-Identifier: MIT
// Pin control overlay for PAW3395 shield

&pinctrl {
    spi3_led: spi3_led {
        group1 {
            psels = <NRF_PSEL(SPIM_MOSI, 0, 2)>;  // D0 - SK6812MINI-E data line
        };
    };
};
