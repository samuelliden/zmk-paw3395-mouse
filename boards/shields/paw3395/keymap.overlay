// SPDX-License-Identifier: MIT

#include <dt-bindings/zmk/mouse.h>
#include <dt-bindings/zmk/keys.h>
#include <dt-bindings/zmk/rgb.h>

/ {
    keymap {
        compatible = "zmk,keymap";

        default_layer {
            bindings = <
                &rgb_ug RGB_EFF  // D1 - Button cycles through RGB effects
                &mkp LCLK        // D3 - Mouse switch 1 (Left Click)
                &mkp RCLK        // D4 - Mouse switch 2 (Right Click)
            >;
            
            sensor-bindings = <&inc_dec_kp C_VOL_UP C_VOL_DN>;  // Scrollwheel
        };
    };
};